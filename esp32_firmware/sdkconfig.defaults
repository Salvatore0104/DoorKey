## esp32_firmware/sdkconfig.defaults
```kconfig
# ESP32-S3 门禁终端配置

# CPU 240MHz (H.264解码需要满速)
CONFIG_ESP_DEFAULT_CPU_FREQ_MHZ_240=y

# PSRAM (H.264解码必需，8MB Octal)
CONFIG_SPIRAM=y
CONFIG_SPIRAM_MODE_OCT=y
CONFIG_SPIRAM_SPEED_80M=y
CONFIG_SPIRAM_ALLOW_STACK_EXTERNAL_MEMORY=y

# Flash 16MB QIO 80MHz
CONFIG_ESPTOOLPY_FLASHSIZE_16MB=y
CONFIG_ESPTOOLPY_FLASHMODE_QIO=y
CONFIG_ESPTOOLPY_FLASHFREQ_80M=y

# FreeRTOS 1000Hz
CONFIG_FREERTOS_HZ=1000

# 编译器性能优化
CONFIG_COMPILER_OPTIMIZATION_PERF=y
CONFIG_COMPILER_OPTIMIZATION_ASSERTIONS_ENABLE=y

# LWIP 双网卡
CONFIG_LWIP_TCPIP_TASK_AFFINITY_NO_AFFINITY=y

# WiFi
CONFIG_ESP_WIFI_STATIC_RX_BUFFER_NUM=16
CONFIG_ESP_WIFI_DYNAMIC_RX_BUFFER_NUM=32
CONFIG_ESP_WIFI_DYNAMIC_TX_BUFFER_NUM=32
```
